.equ MPU6050_ADDRESS_W = 0b11010000 ; Address with end write bit
.equ MPU6050_ADDRESS_R = 0b11010001 ; Address with end read bit
.equ MPU6050_RA_XG_OFFS_TC = 0x00 ;[7] PWR_MODE, [6:1] XG_OFFS_TC, [0] OTP_BNK_VLD
.equ MPU6050_RA_YG_OFFS_TC = 0x01 ;[7] PWR_MODE, [6:1] YG_OFFS_TC, [0] OTP_BNK_VLD
.equ MPU6050_RA_ZG_OFFS_TC = 0x02 ;[7] PWR_MODE, [6:1] ZG_OFFS_TC, [0] OTP_BNK_VLD
.equ MPU6050_RA_X_FINE_GAIN = 0x03 ;[7:0] X_FINE_GAIN
.equ MPU6050_RA_Y_FINE_GAIN = 0x04 ;[7:0] Y_FINE_GAIN
.equ MPU6050_RA_Z_FINE_GAIN = 0x05 ;[7:0] Z_FINE_GAIN
.equ MPU6050_RA_XA_OFFS_H = 0x06 ;[15:0] XA_OFFS
.equ MPU6050_RA_XA_OFFS_L_TC = 0x07
.equ MPU6050_RA_YA_OFFS_H = 0x08 ;[15:0] YA_OFFS
.equ MPU6050_RA_YA_OFFS_L_TC = 0x09
.equ MPU6050_RA_ZA_OFFS_H = 0x0A ;[15:0] ZA_OFFS
.equ MPU6050_RA_ZA_OFFS_L_TC = 0x0B
.equ MPU6050_RA_XG_OFFS_USRH = 0x13 ;[15:0] XG_OFFS_USR
.equ MPU6050_RA_XG_OFFS_USRL = 0x14
.equ MPU6050_RA_YG_OFFS_USRH = 0x15 ;[15:0] YG_OFFS_USR
.equ MPU6050_RA_YG_OFFS_USRL = 0x16
.equ MPU6050_RA_ZG_OFFS_USRH = 0x17 ;[15:0] ZG_OFFS_USR
.equ MPU6050_RA_ZG_OFFS_USRL = 0x18
.equ MPU6050_RA_SMPLRT_DIV = 0x19
.equ MPU6050_RA_CONFIG = 0x1A
.equ MPU6050_RA_GYRO_CONFIG = 0x1B
.equ MPU6050_RA_ACCEL_CONFIG = 0x1C
.equ MPU6050_RA_FF_THR = 0x1D
.equ MPU6050_RA_FF_DUR = 0x1E
.equ MPU6050_RA_MOT_THR = 0x1F
.equ MPU6050_RA_MOT_DUR = 0x20
.equ MPU6050_RA_ZRMOT_THR = 0x21
.equ MPU6050_RA_ZRMOT_DUR = 0x22
.equ MPU6050_RA_FIFO_EN = 0x23
.equ MPU6050_RA_I2C_MST_CTRL = 0x24
.equ MPU6050_RA_I2C_SLV0_ADDR = 0x25
.equ MPU6050_RA_I2C_SLV0_REG = 0x26
.equ MPU6050_RA_I2C_SLV0_CTRL = 0x27
.equ MPU6050_RA_I2C_SLV1_ADDR = 0x28
.equ MPU6050_RA_I2C_SLV1_REG = 0x29
.equ MPU6050_RA_I2C_SLV1_CTRL = 0x2A
.equ MPU6050_RA_I2C_SLV2_ADDR = 0x2B
.equ MPU6050_RA_I2C_SLV2_REG = 0x2C
.equ MPU6050_RA_I2C_SLV2_CTRL = 0x2D
.equ MPU6050_RA_I2C_SLV3_ADDR = 0x2E
.equ MPU6050_RA_I2C_SLV3_REG = 0x2F
.equ MPU6050_RA_I2C_SLV3_CTRL = 0x30
.equ MPU6050_RA_I2C_SLV4_ADDR = 0x31
.equ MPU6050_RA_I2C_SLV4_REG = 0x32
.equ MPU6050_RA_I2C_SLV4_DO = 0x33
.equ MPU6050_RA_I2C_SLV4_CTRL = 0x34
.equ MPU6050_RA_I2C_SLV4_DI = 0x35
.equ MPU6050_RA_I2C_MST_STATUS = 0x36
.equ MPU6050_RA_INT_PIN_CFG = 0x37
.equ MPU6050_RA_INT_ENABLE = 0x38
.equ MPU6050_RA_DMP_INT_STATUS = 0x39
.equ MPU6050_RA_INT_STATUS = 0x3A
.equ MPU6050_RA_ACCEL_XOUT_H = 0x3B
.equ MPU6050_RA_ACCEL_XOUT_L = 0x3C
.equ MPU6050_RA_ACCEL_YOUT_H = 0x3D
.equ MPU6050_RA_ACCEL_YOUT_L = 0x3E
.equ MPU6050_RA_ACCEL_ZOUT_H = 0x3F
.equ MPU6050_RA_ACCEL_ZOUT_L = 0x40
.equ MPU6050_RA_TEMP_OUT_H = 0x41
.equ MPU6050_RA_TEMP_OUT_L = 0x42
.equ MPU6050_RA_GYRO_XOUT_H = 0x43
.equ MPU6050_RA_GYRO_XOUT_L = 0x44
.equ MPU6050_RA_GYRO_YOUT_H = 0x45
.equ MPU6050_RA_GYRO_YOUT_L = 0x46
.equ MPU6050_RA_GYRO_ZOUT_H = 0x47
.equ MPU6050_RA_GYRO_ZOUT_L = 0x48
.equ MPU6050_RA_EXT_SENS_DATA_00 = 0x49
.equ MPU6050_RA_EXT_SENS_DATA_01 = 0x4A
.equ MPU6050_RA_EXT_SENS_DATA_02 = 0x4B
.equ MPU6050_RA_EXT_SENS_DATA_03 = 0x4C
.equ MPU6050_RA_EXT_SENS_DATA_04 = 0x4D
.equ MPU6050_RA_EXT_SENS_DATA_05 = 0x4E
.equ MPU6050_RA_EXT_SENS_DATA_06 = 0x4F
.equ MPU6050_RA_EXT_SENS_DATA_07 = 0x50
.equ MPU6050_RA_EXT_SENS_DATA_08 = 0x51
.equ MPU6050_RA_EXT_SENS_DATA_09 = 0x52
.equ MPU6050_RA_EXT_SENS_DATA_10 = 0x53
.equ MPU6050_RA_EXT_SENS_DATA_11 = 0x54
.equ MPU6050_RA_EXT_SENS_DATA_12 = 0x55
.equ MPU6050_RA_EXT_SENS_DATA_13 = 0x56
.equ MPU6050_RA_EXT_SENS_DATA_14 = 0x57
.equ MPU6050_RA_EXT_SENS_DATA_15 = 0x58
.equ MPU6050_RA_EXT_SENS_DATA_16 = 0x59
.equ MPU6050_RA_EXT_SENS_DATA_17 = 0x5A
.equ MPU6050_RA_EXT_SENS_DATA_18 = 0x5B
.equ MPU6050_RA_EXT_SENS_DATA_19 = 0x5C
.equ MPU6050_RA_EXT_SENS_DATA_20 = 0x5D
.equ MPU6050_RA_EXT_SENS_DATA_21 = 0x5E
.equ MPU6050_RA_EXT_SENS_DATA_22 = 0x5F
.equ MPU6050_RA_EXT_SENS_DATA_23 = 0x60
.equ MPU6050_RA_MOT_DETECT_STATUS = 0x61
.equ MPU6050_RA_I2C_SLV0_DO = 0x63
.equ MPU6050_RA_I2C_SLV1_DO = 0x64
.equ MPU6050_RA_I2C_SLV2_DO = 0x65
.equ MPU6050_RA_I2C_SLV3_DO = 0x66
.equ MPU6050_RA_I2C_MST_DELAY_CTRL = 0x67
.equ MPU6050_RA_SIGNAL_PATH_RESET = 0x68
.equ MPU6050_RA_MOT_DETECT_CTRL = 0x69
.equ MPU6050_RA_USER_CTRL = 0x6A
.equ MPU6050_RA_PWR_MGMT_1 = 0x6B
.equ MPU6050_RA_PWR_MGMT_2 = 0x6C
.equ MPU6050_RA_BANK_SEL = 0x6D
.equ MPU6050_RA_MEM_START_ADDR = 0x6E
.equ MPU6050_RA_MEM_R_W = 0x6F
.equ MPU6050_RA_DMP_CFG_1 = 0x70
.equ MPU6050_RA_DMP_CFG_2 = 0x71
.equ MPU6050_RA_FIFO_COUNTH = 0x72
.equ MPU6050_RA_FIFO_COUNTL = 0x73
.equ MPU6050_RA_FIFO_R_W = 0x74
.equ MPU6050_RA_WHO_AM_I = 0x75
